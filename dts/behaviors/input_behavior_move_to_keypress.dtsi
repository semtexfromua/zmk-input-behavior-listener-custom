/*
 * Copyright (c) 2020 The ZMK Contributors
 *
 * SPDX-License-Identifier: MIT
 */

/ {
    behaviors {
        /omit-if-no-ref/ ib_move_to_arrow: input_behavior_move_to_keypress {
            compatible = "zmk,input-behavior-move-to-keypress";
            #binding-cells = <0>;
            threshold = <300>;        // Безпечний поріг для запобігання зависанню
            rate-limit-ms = <50>;     // Обмеження частоти між events
            bindings = <&kp RIGHT>, <&kp LEFT>, <&kp UP>, <&kp DOWN>;
        };
    };
}; 