## dts/bindings/zmk,input-behavior-move-to-keypress.yaml
```yaml
# Copyright (c) 2024 The ZMK Contributors
# SPDX-License-Identifier: MIT

description: Input behavior for converting trackball movement to keypress events

compatible: "zmk,input-behavior-move-to-keypress"

include: base.yaml

properties:
  threshold:
    type: int
    default: 50
    description: Default threshold value for triggering movement

  x-threshold:
    type: int
    description: Threshold for X-axis movement (overrides general threshold if set)

  y-threshold:
    type: int
    description: Threshold for Y-axis movement (overrides general threshold if set)

  rate-limit-ms:
    type: int
    default: 50
    description: Minimum time between key events in milliseconds

  x-invert:
    type: boolean
    description: Invert X-axis direction

  y-invert:
    type: boolean
    description: Invert Y-axis direction

  reset-other-axis:
    type: boolean
    default: false
    description: Reset opposite axis delta when one axis triggers movement

  bindings:
    type: phandles
    required: true
    description: Key bindings for directions (RIGHT, LEFT, UP, DOWN) 
```

## dts/bindings/zmk,input-behavior-sensor-rotate.yaml
```yaml
# Copyright (c) 2020 The ZMK Contributors
# SPDX-License-Identifier: MIT

description: Input Behavior Sensor Rotate

compatible: "zmk,input-behavior-sensor-rotate"

properties:
  threshold:
    type: int
    default: 50
    description: "Threshold value for triggering key events"
  x-invert:
    type: boolean
    description: "Invert X axis direction"
  y-invert:
    type: boolean  
    description: "Invert Y axis direction"
  bindings:
    type: phandle-array
    required: true
    description: "Key bindings for right, left, up, down movements"
  "#sensor-binding-cells":
    type: int
    const: 4
    description: "Number of cells in bindings (right, left, up, down)"

sensor-binding-cells:
  - right
  - left  
  - up
  - down 
```
